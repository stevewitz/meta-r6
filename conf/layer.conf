## conf/layer.conf
```bitbake
# We have a conf and classes directory, append to BBPATH
BBPATH .= ":${LAYERDIR}"

# We have a recipes directory, add to BBFILES
BBFILES += "${LAYERDIR}/recipes-*/*/*.bb ${LAYERDIR}/recipes-*/*/*.bbappend"

BBFILE_COLLECTIONS += "r6"
BBFILE_PATTERN_r6 := "^${LAYERDIR}/"
BBFILE_PRIORITY_r6 = "7"

LAYERVERSION_r6 = "1"
LAYERSERIES_COMPAT_r6 = "rocko sumo thud"
```
